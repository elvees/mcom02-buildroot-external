## Config.in
```kconfig
menu "Toolchains"
source "$BR2_EXTERNAL_MCOM02_PATH/toolchain/toolchain-elcore30m/Config.in"
endmenu

menu "Target packages"

menu "MCom platform"
source "$BR2_EXTERNAL_MCOM02_PATH/package/mcom/mcom-delcore30m-tests/Config.in"
source "$BR2_EXTERNAL_MCOM02_PATH/package/mcom/mcom-fc-dsp/Config.in"
source "$BR2_EXTERNAL_MCOM02_PATH/package/mcom/mcom-libdsp/Config.in"
source "$BR2_EXTERNAL_MCOM02_PATH/package/mcom/mcom-libmali/Config.in"
source "$BR2_EXTERNAL_MCOM02_PATH/package/mcom/mcom-libswic/Config.in"
source "$BR2_EXTERNAL_MCOM02_PATH/package/mcom/mcom-libump/Config.in"
source "$BR2_EXTERNAL_MCOM02_PATH/package/mcom/mcom-linux-tests/Config.in"
source "$BR2_EXTERNAL_MCOM02_PATH/package/mcom/mcom-mali-demos/Config.in"
source "$BR2_EXTERNAL_MCOM02_PATH/package/mcom/mcom-mali-driver/Config.in"
source "$BR2_EXTERNAL_MCOM02_PATH/package/mcom/mcom-python-linux-tests/Config.in"
source "$BR2_EXTERNAL_MCOM02_PATH/package/mcom/mcom-talita/Config.in"
source "$BR2_EXTERNAL_MCOM02_PATH/package/openvx/Config.in"
source "$BR2_EXTERNAL_MCOM02_PATH/package/openvx-cts/Config.in"
source "$BR2_EXTERNAL_MCOM02_PATH/package/openvx-demo/Config.in"
source "$BR2_EXTERNAL_MCOM02_PATH/package/rf2chan-v2-gnss/Config.in"
source "$BR2_EXTERNAL_MCOM02_PATH/package/v4l2tofb/Config.in"
source "$BR2_EXTERNAL_MCOM02_PATH/package/vinc-tools/Config.in"
endmenu

menu "Tests and Benchmarks"
source "$BR2_EXTERNAL_MCOM02_PATH/package/m2m-test/Config.in"
endmenu

endmenu
```

## configs/mcom_defconfig
```kconfig
BR2_arm=y
BR2_cortex_a9=y
BR2_ARM_ENABLE_NEON=y
BR2_ARM_ENABLE_VFP=y
BR2_ARM_FPU_NEON=y
BR2_OPTIMIZE_3=y
BR2_TOOLCHAIN_BUILDROOT_GLIBC=y
BR2_PACKAGE_HOST_LINUX_HEADERS_CUSTOM_4_4=y
BR2_GCC_VERSION_7_X=y
BR2_TOOLCHAIN_BUILDROOT_CXX=y
BR2_GCC_ENABLE_LTO=y
BR2_GCC_ENABLE_GRAPHITE=y
BR2_PACKAGE_HOST_GDB=y
BR2_PACKAGE_HOST_GDB_TUI=y
BR2_PACKAGE_HOST_GDB_PYTHON=y
BR2_TARGET_GENERIC_HOSTNAME="mcom02"
BR2_TARGET_GENERIC_ISSUE="Welcome!"
BR2_INIT_SYSTEMD=y
BR2_TARGET_GENERIC_ROOT_PASSWD="root"
# BR2_TARGET_GENERIC_GETTY is not set
BR2_SYSTEM_DHCP="eth0"
BR2_ROOTFS_OVERLAY="${BR2_EXTERNAL}/overlay/elvees"
BR2_LINUX_KERNEL=y
BR2_LINUX_KERNEL_CUSTOM_GIT=y
BR2_LINUX_KERNEL_CUSTOM_REPO_URL="https://github.com/elvees/linux"
BR2_LINUX_KERNEL_CUSTOM_REPO_VERSION="mcom02/v4.4.162.5"
BR2_LINUX_KERNEL_DEFCONFIG="mcom"
BR2_PACKAGE_BUSYBOX_CONFIG="${BR2_EXTERNAL}/board/elvees/busybox.config"
BR2_PACKAGE_ALSA_UTILS=y
BR2_PACKAGE_ALSA_UTILS_ALSAUCM=y
BR2_PACKAGE_ALSA_UTILS_AMIXER=y
BR2_PACKAGE_ALSA_UTILS_APLAY=y
BR2_PACKAGE_ALSA_UTILS_SPEAKER_TEST=y
BR2_PACKAGE_FFMPEG_GPL=y
BR2_PACKAGE_FFMPEG_FFPLAY=y
BR2_PACKAGE_GSTREAMER1=y
BR2_PACKAGE_GST1_PLUGINS_BASE_PLUGIN_TCP=y
BR2_PACKAGE_GST1_PLUGINS_GOOD_PLUGIN_RTSP=y
BR2_PACKAGE_GST1_PLUGINS_GOOD_PLUGIN_V4L2=y
BR2_PACKAGE_GST1_PLUGINS_GOOD_PLUGIN_V4L2_PROBE=y
BR2_PACKAGE_GST1_PLUGINS_BAD=y
BR2_PACKAGE_GST1_PLUGINS_BAD_PLUGIN_RAWPARSE=y
BR2_PACKAGE_GST1_PLUGINS_BAD_PLUGIN_VIDEOPARSERS=y
BR2_PACKAGE_GST1_PLUGINS_BAD_PLUGIN_OPENH264=y
BR2_PACKAGE_GST1_PLUGINS_UGLY=y
BR2_PACKAGE_GST1_PLUGINS_UGLY_PLUGIN_X264=y
BR2_PACKAGE_GST1_RTSP_SERVER=y
BR2_PACKAGE_MPLAYER=y
BR2_PACKAGE_BONNIE=y
BR2_PACKAGE_DHRYSTONE=y
BR2_PACKAGE_FIO=y
BR2_PACKAGE_OPROFILE=y
BR2_PACKAGE_RAMSMP=y
BR2_PACKAGE_RAMSPEED=y
BR2_PACKAGE_BINUTILS_TARGET=y
BR2_PACKAGE_E2FSPROGS=y
BR2_PACKAGE_MTD=y
BR2_PACKAGE_FBSET=y
BR2_PACKAGE_FBV=y
BR2_PACKAGE_LINUX_FIRMWARE=y
BR2_PACKAGE_LINUX_FIRMWARE_BRCM_BCM43XXX=y
BR2_PACKAGE_HDPARM=y
BR2_PACKAGE_I2C_TOOLS=y
BR2_PACKAGE_MEMTESTER=y
BR2_PACKAGE_PARTED=y
BR2_PACKAGE_SYSSTAT=y
BR2_PACKAGE_PYTHON=y
BR2_PACKAGE_PYTHON_SERIAL=y
BR2_PACKAGE_PYTHON_SETUPTOOLS=y
BR2_PACKAGE_LIBDRM=y
BR2_PACKAGE_LIBDRM_INSTALL_TESTS=y
BR2_PACKAGE_LIBV4L=y
BR2_PACKAGE_LIBV4L_UTILS=y
BR2_PACKAGE_X264_CLI=y
BR2_PACKAGE_NCURSES_TARGET_PROGS=y
BR2_PACKAGE_BLUEZ5_UTILS=y
BR2_PACKAGE_BLUEZ5_UTILS_OBEX=y
BR2_PACKAGE_BLUEZ5_UTILS_CLIENT=y
BR2_PACKAGE_BLUEZ5_UTILS_TEST=y
BR2_PACKAGE_CAN_UTILS=y
BR2_PACKAGE_CRDA=y
BR2_PACKAGE_ETHTOOL=y
BR2_PACKAGE_HOSTAPD=y
BR2_PACKAGE_HOSTAPD_EAP=y
BR2_PACKAGE_IPERF=y
BR2_PACKAGE_IPERF3=y
BR2_PACKAGE_IPROUTE2=y
BR2_PACKAGE_IW=y
BR2_PACKAGE_OPENSSH=y
BR2_PACKAGE_TCPDUMP=y
BR2_PACKAGE_WIRELESS_TOOLS=y
BR2_PACKAGE_WPA_SUPPLICANT=y
BR2_PACKAGE_WPA_SUPPLICANT_CLI=y
BR2_PACKAGE_WPA_SUPPLICANT_PASSPHRASE=y
BR2_PACKAGE_BASH=y
BR2_PACKAGE_UTIL_LINUX_SCHEDUTILS=y
BR2_PACKAGE_NANO=y
BR2_PACKAGE_HOST_CMAKE=y
BR2_PACKAGE_HOST_MTOOLS=y
BR2_PACKAGE_AUDIO_TESTS=y
BR2_PACKAGE_MCOM_FC_DSP=y
BR2_PACKAGE_MCOM_LINUX_TESTS=y
BR2_PACKAGE_MCOM_MALI_DEMOS=y
BR2_PACKAGE_OPENVX_DEMO=y
BR2_PACKAGE_UART_LOOPBACK_TEST=y
BR2_PACKAGE_V4L2TOFB=y
BR2_PACKAGE_COREMARK=y
BR2_PACKAGE_M2M_TEST=y
```

## configs/mcommin_defconfig
```kconfig
BR2_arm=y
BR2_cortex_a9=y
BR2_ARM_ENABLE_NEON=y
BR2_ARM_ENABLE_VFP=y
BR2_OPTIMIZE_3=y
BR2_TOOLCHAIN_EXTERNAL=y
BR2_TARGET_GENERIC_HOSTNAME="mcom02"
BR2_TARGET_GENERIC_ISSUE="Welcome!"
BR2_INIT_SYSTEMD=y
BR2_TARGET_GENERIC_ROOT_PASSWD="root"
# BR2_TARGET_GENERIC_GETTY is not set
BR2_SYSTEM_DHCP="eth0"
BR2_ROOTFS_OVERLAY="${BR2_EXTERNAL_MCOM02_PATH}/overlay/elvees"
BR2_ROOTFS_POST_IMAGE_SCRIPT="support/scripts/genimage.sh"
BR2_ROOTFS_POST_SCRIPT_ARGS="-c ${BR2_EXTERNAL_MCOM02_PATH}/board/elvees/sd-image.cfg"
BR2_LINUX_KERNEL=y
BR2_LINUX_KERNEL_CUSTOM_GIT=y
BR2_LINUX_KERNEL_CUSTOM_REPO_URL="https://github.com/elvees/linux"
BR2_LINUX_KERNEL_CUSTOM_REPO_VERSION="mcom02/v4.4.189.1"
BR2_LINUX_KERNEL_DEFCONFIG="mcom"
BR2_LINUX_KERNEL_INSTALL_TARGET=y
BR2_PACKAGE_BUSYBOX_CONFIG="${BR2_EXTERNAL_MCOM02_PATH}/board/elvees/busybox.config"
BR2_PACKAGE_OPENSSH=y
BR2_PACKAGE_BASH=y
BR2_TARGET_ROOTFS_EXT2=y
BR2_TARGET_ROOTFS_EXT2_4=y
BR2_TARGET_ROOTFS_EXT2_LABEL="root"
BR2_TARGET_ROOTFS_EXT2_SIZE="1000M"
BR2_PACKAGE_HOST_GENIMAGE=y
```

## package/audio-tests/Config.in
```kconfig
config BR2_PACKAGE_AUDIO_TESTS
	bool "audio-tests"
	depends on BR2_PACKAGE_PYTHON_NUMPY_ARCH_SUPPORTS
	depends on BR2_PACKAGE_PYTHON || BR2_PACKAGE_PYTHON3
	select BR2_PACKAGE_PYTHON_NUMPY
	help
	  Audio-tests package contains an utility to test
	  audio input/output. It analyzes WAV file and print
	  amplitude, frequency and noise level for each channel.
```

## package/avico-driver/Config.in
```kconfig
config BR2_PACKAGE_AVICO_DRIVER
	bool "Avico driver"
	depends on BR2_LINUX_KERNEL
	help
	  Kernel driver for Avico (a.k.a. VELcore-01) HW encoder/decoder

comment "Avico driver needs a Linux kernel to be built"
	depends on !BR2_LINUX_KERNEL
```

## package/cimg/Config.in
```kconfig
config BR2_PACKAGE_CIMG
	bool "cimg"
	select BR2_PACKAGE_LIBPNG
	select BR2_PACKAGE_JPEG
	help
	  A small and open-source C++ toolkit for image processing
```

## package/dmatestcontig/Config.in
```kconfig
config BR2_PACKAGE_DMATESTCONTIG
	bool "dmatestcontig"
	help
	  A kernel module for benchmarking DMA speed on large
	  contiguous buffers.
```

## package/igt-gpu-tools/Config.in
```kconfig
config BR2_PACKAGE_IGT_GPU_TOOLS
	bool "igt-gpu-tools"

	depends on BR2_PACKAGE_LIBUNWIND_ARCH_SUPPORTS
	depends on BR2_PACKAGE_XORG7
	depends on !BR2_STATIC_LIBS
	depends on BR2_TOOLCHAIN_HAS_THREADS
	depends on BR2_USE_MMU

	select BR2_PACKAGE_CAIRO
	select BR2_PACKAGE_CAIRO_PNG
	select BR2_PACKAGE_KMOD
	select BR2_PACKAGE_LIBDRM
	select BR2_PACKAGE_LIBPCIACCESS
	select BR2_PACKAGE_LIBUNWIND
	select BR2_PACKAGE_PROCPS_NG
	select BR2_PACKAGE_XPROTO_DRI2PROTO
	select BR2_PACKAGE_XUTIL_UTIL_MACROS

	# these dependencies required by Piglit that is used to run the tests
	# as preferred test system
	select BR2_PACKAGE_PYTHON_BZIP2 if BR2_PACKAGE_PYTHON
	select BR2_PACKAGE_PYTHON_MAKO if BR2_PACKAGE_PYTHON
	select BR2_PACKAGE_PYTHON_MARKUPSAFE if BR2_PACKAGE_PYTHON
	select BR2_PACKAGE_PYTHON_SIX if BR2_PACKAGE_PYTHON

	help
	  Utilities provided by Intel for testing DRM video drivers.
```

## package/libuio/Config.in
```kconfig
config BR2_PACKAGE_LIBUIO
	bool "libuio"
	help
	  Userspace I/O library which serve as a
	  linux backend for sgbmdriver
```

## package/m2m-test/Config.in
```kconfig
config BR2_PACKAGE_M2M_TEST
	bool "M2M test"
	select BR2_PACKAGE_FFMPEG
	imply BR2_PACKAGE_LIBDRM
	imply BR2_PACKAGE_SDL2
	help
	  Testing application for V4L2 M2M devices

if BR2_PACKAGE_M2M_TEST

comment "dec-vpout won't be built, because libdrm or sdl2 isn't selected"
	depends on !BR2_PACKAGE_LIBDRM || !BR2_PACKAGE_SDL2

endif
```

## package/mcom/mcom-checkers/Config.in
```kconfig
config BR2_PACKAGE_MCOM_CHECKERS
	bool "Checkers for MCom testing"
	default n
	help
	  Python library libchecker and scripts for mcom testing
```

## package/mcom/mcom-delcore30m-tests/Config.in
```kconfig
config BR2_PACKAGE_MCOM_DELCORE30M_TESTS
	bool "delcore30m tests"
	depends on BR2_PACKAGE_LIBDRM
	depends on BR2_PACKAGE_PYTHON3
	select BR2_PACKAGE_GOOGLEFONTDIRECTORY
	select BR2_TOOLCHAIN_ELCORE30M
	help
	  Testing applications for delcore30m driver.

comment "delcore30m tests need libdrm"
	depends on !BR2_PACKAGE_LIBDRM
comment "delcore30m tests need Python"
	depends on !BR2_PACKAGE_PYTHON3
```

## package/mcom/mcom-fc-dsp/Config.in
```kconfig
config BR2_PACKAGE_MCOM_FC_DSP
	bool "fc-dsp"
	default n
	select BR2_PACKAGE_MCOM_LIBDSP
	help
	  Functional test for Elcore-30M DSP
```

## package/mcom/mcom-libdsp/Config.in
```kconfig
config BR2_PACKAGE_MCOM_LIBDSP
	bool "libdsp"
	help
	  Library to access DSP cores from userspace
```

## package/mcom/mcom-libmali/Config.in
```kconfig
config BR2_PACKAGE_MCOM_LIBMALI
	bool "libmali"
	select BR2_PACKAGE_MCOM_LIBUMP
	select BR2_PACKAGE_MCOM_MALI_DRIVER
	select BR2_PACKAGE_HAS_LIBEGL
	select BR2_PACKAGE_HAS_LIBGLES
	help
	  Mali GPU library for MCom platform

if BR2_PACKAGE_MCOM_LIBMALI

config BR2_PACKAGE_PROVIDES_LIBEGL
	default "mcom-libmali"

config BR2_PACKAGE_PROVIDES_LIBGLES
	default "mcom-libmali"

endif
```

## package/mcom/mcom-libswic/Config.in
```kconfig
config BR2_PACKAGE_MCOM_LIBSWIC
	bool "libswic"
	help
	  Applications and tests for MCom-02 SWIC driver
```

## package/mcom/mcom-libump/Config.in
```kconfig
config BR2_PACKAGE_MCOM_LIBUMP
	bool "libump"
	help
	  Unified Memory Provider library for Mali GPUs
```

## package/mcom/mcom-linux-tests/Config.in
```kconfig
config BR2_PACKAGE_MCOM_LINUX_TESTS
	bool "MCom Linux tests"
	select BR2_PACKAGE_DMATESTCONTIG
	select BR2_PACKAGE_MEMTESTER_SIMPLE
	help
	  Different tests and tools for MCom platform

if BR2_PACKAGE_MCOM_LINUX_TESTS

config BR2_PACKAGE_MCOM_LINUX_TESTS_MALI_UTILS
	bool "Utils for proprietary Mali driver"
	default n
	select BR2_PACKAGE_MCOM_MALI_DEMOS
	help
	  Utils for proprietary Mali Driver

config BR2_PACKAGE_MCOM_LINUX_TESTS_DMATESTCONTIG
	bool "Script to use dmatestcontig driver"
	default n
	select BR2_PACKAGE_DMATESTCONTIG
	help
	  Script to use dmatestcontig driver

endif
```

## package/mcom/mcom-mali-demos/Config.in
```kconfig
config BR2_PACKAGE_MCOM_MALI_DEMOS
	bool "mali-demos"
	select BR2_PACKAGE_MCOM_LIBMALI
	help
	  A set of applications for demonstrating 3D-acceleration
	  on Mali GPU.
```

## package/mcom/mcom-mali-driver/Config.in
```kconfig
config BR2_PACKAGE_MCOM_MALI_DRIVER
	bool "mali-driver"
	default n
	depends on BR2_LINUX_KERNEL
	help
	  Mali GPU driver and library for MCom platform

comment "Mali driver needs a Linux kernel to be built"
	depends on !BR2_LINUX_KERNEL
```

## package/mcom/mcom-python-linux-tests/Config.in
```kconfig
config BR2_PACKAGE_MCOM_PYTHON_LINUX_TESTS
	bool "MCom Python Linux tests"
	select BR2_PACKAGE_MCOM_LINUX_TESTS
	select BR2_PACKAGE_PYTHON3
	select BR2_PACKAGE_PYTHON_PARALLEL_TEST
	select BR2_PACKAGE_PYTHON_SETUPTOOLS
	select BR2_PACKAGE_UTIL_LINUX
	select BR2_PACKAGE_UTIL_LINUX_BINARIES
	help
	  Various Python tests and tools for MCom-02 platform
```

## package/mcom/mcom-talita/Config.in
```kconfig
config BR2_PACKAGE_MCOM_TALITA
	bool "talita"
	depends on BR2_LINUX_KERNEL
	select BR2_PACKAGE_RF2CHAN_V2_GNSS
	help
	  An ELVEES GNSS proprietary binary driver which is indended to
	  be used for Salute-EL24D1 with RF2Chan v2 front end module
comment "talita needs a Linux kernel to be built"
	depends on !BR2_LINUX_KERNEL
```

## package/memtester-simple/Config.in
```kconfig
config BR2_PACKAGE_MEMTESTER_SIMPLE
	bool "memtester-simple"
	default y
	help
	  Simplified version of memtester
```

## package/openvx-cts/Config.in
```kconfig
config BR2_PACKAGE_OPENVX_CTS
	bool "openvx-cts"
	select BR2_PACKAGE_OPENVX
	help
	  OpenVX Conformance Test Suite to validate OpenVX library
```
