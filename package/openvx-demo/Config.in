## package/openvx-demo/Config.in
```kconfig
config BR2_PACKAGE_OPENVX_DEMO
	bool "openvx-demo"
	select BR2_PACKAGE_OPENVX
	select BR2_PACKAGE_CIMG
	help
	  A bunch of samples of OpenVX library usage
```

## package/openvx-headers/Config.in
```kconfig
config BR2_PACKAGE_OPENVX_HEADERS
	bool "openvx-headers"
	help
	  An OpenVX standard headers
```

## package/openvx/Config.in
```kconfig
config BR2_PACKAGE_OPENVX
	bool "openvx"
	depends on BR2_ARM_EABIHF
	depends on BR2_SHARED_LIBS
	depends on BR2_TOOLCHAIN_USES_GLIBC
	select BR2_PACKAGE_HAS_OPENVX_VIRTUAL
	select BR2_PACKAGE_OPENVX_HEADERS
	help
	  An OpenVX library.
	  Compiled with: libc.so.6, libm.so.6, libdl.so.2, arm EABIhf

if BR2_PACKAGE_OPENVX

config BR2_PACKAGE_PROVIDES_OPENVX_VIRTUAL
	default "openvx"

endif
```

## package/rf2chan-v2-gnss/Config.in
```kconfig
config BR2_PACKAGE_RF2CHAN_V2_GNSS
	bool "rf2chan v2 gnss"
	depends on BR2_LINUX_KERNEL
	help
	  A kernel module for RF2Chan v2 GNNS front end module.

comment "rf2chan v2 gnss driver needs a Linux kernel to be built"
	depends on !BR2_LINUX_KERNEL
```

## package/uart-loopback-test/Config.in
```kconfig
config BR2_PACKAGE_UART_LOOPBACK_TEST
	bool "uart-loopback-test"
	help
	  Python test for uart in loopback mode
```

## package/v4l2tofb/Config.in
```kconfig
config BR2_PACKAGE_V4L2TOFB
	bool "v4l2tofb"
	default n
	depends on BR2_PACKAGE_LIBDRM
	help
	  Utility for displaying video from V4L2 device to fb device.
```

## package/vinc-tools/Config.in
```kconfig
config BR2_PACKAGE_VINC_TOOLS
	bool "vinc-tools"
	help
	  Utilities to manage VINC ISP V4L2 device
```

## toolchain/toolchain-elcore30m/Config.in
```kconfig
config BR2_TOOLCHAIN_ELCORE30M
	bool "ELcore-30M toolchain"
	help
	  Download and prepare ELcore-30M toolchain
```
